## target/templates/ath79_nand_defconfig
```kconfig
CONFIG_TARGET_ath79=y
CONFIG_TARGET_ath79_nand=y
CONFIG_ALL_KMODS=y
CONFIG_TARGET_MULTI_PROFILE=y
CONFIG_DEVEL=y
CONFIG_AUTOREMOVE=y
CONFIG_TARGET_ALL_PROFILES=y
CONFIG_LINUX_6_18=y
CONFIG_TESTING_KERNEL=y
```

## target/templates/mediatek_mt7629_defconfig
```kconfig
CONFIG_TARGET_mediatek=y
CONFIG_TARGET_mediatek_mt7629=y
CONFIG_ALL_KMODS=y
CONFIG_TARGET_MULTI_PROFILE=y
CONFIG_DEVEL=y
CONFIG_AUTOREMOVE=y
CONFIG_TARGET_ALL_PROFILES=y
CONFIG_LINUX_6_18=y
CONFIG_TESTING_KERNEL=y
```

## target/templates/ramips_mt7621_defconfig
```kconfig
CONFIG_TARGET_ramips=y
CONFIG_TARGET_ramips_mt7621=y
CONFIG_ALL_KMODS=y
CONFIG_TARGET_MULTI_PROFILE=y
CONFIG_DEVEL=y
CONFIG_AUTOREMOVE=y
CONFIG_TARGET_ALL_PROFILES=y
CONFIG_LINUX_6_18=y
CONFIG_TESTING_KERNEL=y
```

## target/templates/x86_legacy_defconfig
```kconfig
CONFIG_TARGET_x86=y
CONFIG_TARGET_x86_legacy=y
CONFIG_ALL_KMODS=y
CONFIG_TARGET_MULTI_PROFILE=y
CONFIG_DEVEL=y
CONFIG_AUTOREMOVE=y
CONFIG_TARGET_ALL_PROFILES=y
CONFIG_LINUX_6_18=y
CONFIG_TESTING_KERNEL=y
```

## templates/belkin_f9k1109v1_defconfig
```kconfig
CONFIG_TARGET_ramips=y
CONFIG_TARGET_ramips_rt3883=y
CONFIG_TARGET_ramips_rt3883_DEVICE_belkin_f9k1109v1=y
```

## templates/ramips_mt7620_defconfig
```kconfig
CONFIG_TARGET_ramips=y
CONFIG_TARGET_ramips_mt7620=y
CONFIG_TARGET_MULTI_PROFILE=y
CONFIG_TARGET_DEVICE_ramips_mt7620_DEVICE_haier_hw-l1w=y
CONFIG_PACKAGE_RT2X00_LIB_DEBUGFS=y
CONFIG_TARGET_PER_DEVICE_ROOTFS=y
```

## templates/x86_geode_defconfig
```kconfig
CONFIG_TARGET_x86=y
CONFIG_TARGET_x86_geode=y
CONFIG_TARGET_MULTI_PROFILE=y
CONFIG_TARGET_ALL_PROFILES=y
```

## templates/x86_legacy_defconfig
```kconfig
CONFIG_TARGET_x86=y
CONFIG_TARGET_x86_legacy=y
CONFIG_TARGET_MULTI_PROFILE=y
CONFIG_TARGET_ALL_PROFILES=y
```
